## sdkconfig.defaults
```kconfig
# Lexi-R10H CMUX tuning
CONFIG_ESP_MODEM_CMUX_COMMAND="AT+CMUX=0,0,,127"
CONFIG_ESP_MODEM_CMUX_DELAY_MS_AFTER_COMMAND=250
CONFIG_ESP_MODEM_URC_HANDLER=y
CONFIG_ESP_MODEM_ADD_DEBUG_LOGS=y
```
